////////////////////////////////////////////////////////////////////////////
//                给力者单片机开发学习系统，开发学习都给力！              //
////////////////////////////////////////////////////////////////////////////
//                     学习51单片机，其实可以很简单                       //
////////////////////////////////////////////////////////////////////////////
//                宁波芯动电子有限公司  www.MovingChip.com                //
////////////////////////////////////////////////////////////////////////////

#include <AT89X52.h>       //调用51单片机的头文件

//---------------------------------------
//4×4矩阵式按键相关I/O设置
sbit HAGN1=P1^0;           //第1行接在P3.0口上
sbit HANG2=P1^1;           //第2行接在P3.1口上
sbit HANB3=P1^2;           //第3行接在P3.2口上
sbit HANG4=P1^3;           //第4行接在P3.3口上
sbit LIE1=P1^4;            //第1列接在P3.4口上
sbit LIE2=P1^5;            //第2列接在P3.5口上
sbit LIE3=P1^6;            //第3列接在P3.6口上
sbit LIE4=P1^7;            //第4列接在P3.7口上
//---------------------------------------

//---------------------------------------
//1602液晶相关I/O设置
sbit E=P2^3;               //1602液晶的E脚接在P2.3口上
sbit RW=P2^4;              //1602液晶的RW脚接在P2.4口上
sbit RS=P2^5;              //1602液晶的RS脚接在P2.5口上
//---------------------------------------

//---------------------------------------
//按键部分用寄存器设置
unsigned char KEYbuf;      //设置8位的寄存器用来暂存按键键值数据
//---------------------------------------

//---------------------------------------
//1602液晶寄存器设置
unsigned char DISbuf;     //设置8位的unsigend char型寄存器用来暂存1602要显示的内容
//---------------------------------------

//---------------------------------------
//名称：1602液晶用延时函数
//适用：给力者GL9单片机开发学习系统
//公司：宁波芯动电子有限公司
//网址：www.MovingChip.com
//日期：20120914
//---------------------------------------
void Delay1602(unsigned int t)
{ 
     unsigned int k;      //定义一个16位寄存器用来做延时用 
     for(k=0;k<t;k++);    //延时 
} 

//---------------------------------------
//名称：1602液晶忙检测函数
//适用：给力者GL9单片机开发学习系统
//公司：宁波芯动电子有限公司
//网址：www.MovingChip.com
//日期：20120914
//---------------------------------------
void LCD1602_busy(void)
{ 
     P0_7=1;              //将P0.7置1，为读状态做准备 
     RS=0;                //RS=0、RW=1、E=1时，忙信号输出到DB7，由P0.7读入
     RW=1;                //RS=0、RW=1、E=1时，忙信号输出到DB7，由P0.7读入
     E=1;                 //RS=0、RW=1、E=1时，忙信号输出到DB7，由P0.7读入
     while(P0_7==1);      //由P0.7读入1，表示1602液晶忙，需要等待
     E=0;                 //读完以后，恢复E的电平
} 

//---------------------------------------
//名称：1600写命令函数
//适用：给力者GL9单片机开发学习系统
//公司：宁波芯动电子有限公司
//网址：www.MovingChip.com
//日期：20120914
//---------------------------------------
void LCD1602_Write_com(unsigned char combuf)
{ 
     RS=0;                //选择指令寄存器
     RW=0;                //选择写状态
     P0=combuf;           //将命令字通过P0口送至DB
     E=1;                 //E高电平将命令字写入1602液晶
     E=0;                 //写完以后，恢复E的电平
} 

//---------------------------------------
//名称：1602写命令函数(带忙检测)
//适用：给力者GL9单片机开发学习系统
//公司：宁波芯动电子有限公司
//网址：www.MovingChip.com
//日期：20120914
//---------------------------------------
void LCD1602_Write_com_busy(unsigned char combuf)
{ 
     LCD1602_busy();            //调用忙检测函数
     LCD1602_Write_com(combuf); //调用忙检测函数
} 

//---------------------------------------
//名称：1602写数据函数(带忙检测)
//适用：给力者GL9单片机开发学习系统
//公司：宁波芯动电子有限公司
//网址：www.MovingChip.com
//日期：20120914
//---------------------------------------
void LCD1602_Write_data_busy(unsigned char databuf)
{ 
     LCD1602_busy();      //调用忙检测函数
     RS=1;                //选择数据寄存器
     RW=0;                //选择写状态
     P0=databuf;          //将命令字通过P0口送至DB
     E=1;                 //E高电平将命令字写入1602液晶
     E=0;                 //写完以后，恢复E的电平
} 

//---------------------------------------
//名称：1602液晶显示地址写函数
//适用：给力者GL9单片机开发学习系统
//公司：宁波芯动电子有限公司
//网址：www.MovingChip.com
//日期：20120914
//---------------------------------------
void LCD1602_Write_address(unsigned char x,unsigned char y)
{ 
     x&=0x0f;             //列地址限制在0-15间
     y&=0x01;             //行地址限制在0-1间
     if(y==0)             //如果是第一行
         LCD1602_Write_com_busy(x|0x80);        //将列地址写入
     else                 //如果是第二行
         LCD1602_Write_com_busy((x+0x40)|0x80); //将列地址写入
} 

//---------------------------------------
//名称：1602液晶初始化函数
//适用：给力者GL9单片机开发学习系统
//公司：宁波芯动电子有限公司
//网址：www.MovingChip.com
//日期：20120914
//---------------------------------------
void LCD1602_init(void)
{ 
     Delay1602(1500);               //调用延时函数
     LCD1602_Write_com(0x38);       //8位数据总线，两行显示模式，5*7点阵显示
     Delay1602(500);                //调用延时函数
     LCD1602_Write_com(0x38);       //8位数据总线，两行显示模式，5*7点阵显示
     Delay1602(500);                //调用延时函数
     LCD1602_Write_com(0x38);       //8位数据总线，两行显示模式，5*7点阵显示
     LCD1602_Write_com_busy(0x38);  //8位数据总线，两行显示模式，5*7点阵显示
     LCD1602_Write_com_busy(0x08);  //显示功能关，无光标
     LCD1602_Write_com_busy(0x01);  //清屏
     LCD1602_Write_com_busy(0x06);  //写入新的数据后，光标右移，显示屏不移动
     LCD1602_Write_com_busy(0x0C);  //显示功能开，无光标
} 

//---------------------------------------
//名称：1602液晶指定地址显示函数
//适用：给力者GL9单片机开发学习系统
//公司：宁波芯动电子有限公司
//网址：www.MovingChip.com
//日期：20120914
//---------------------------------------
void LCD1602_Disp(unsigned char x,unsigned char y,unsigned char buf)
{ 
     LCD1602_Write_address(x,y);    //先将地址信息写入
     LCD1602_Write_data_busy(buf);  //再写入要显示的数据
} 

//---------------------------------------
//名称: 主函数
//适用：给力者GL9单片机开发学习系统
//公司：宁波芯动电子有限公司
//网址：www.MovingChip.com
//日期：20120914
//---------------------------------------
void main(void)            //主函数,单片机开机后就是从这个函数开始运行
{

    LCD1602_init();        //调用1602液晶初始化函数
	 KEYbuf=255;
    while(1)               //死循环,单片机初始化后,将一直运行这个死循环
    {
    //***4×4矩阵按键扫描部分***
    //按K1-P16键，KEYbuf赋值0-15
        P1=0xFE;                  //将第一行置零，以扫描K1-K4是否被按下
        if(LIE1==0) KEYbuf=0;     //如果K1键按下，KEYbuf赋值写0
        else if(LIE2==0) KEYbuf=1; //如果K2键按下，KEYbuf赋值写1
        else if(LIE3==0) KEYbuf=2; //如果K3键按下，KEYbuf赋值写2
        else if(LIE4==0) KEYbuf=3; //如果K4键按下，KEYbuf赋值写3

        P1=0xFD;                  //将第二行置零，以扫描K5-K8是否被按下
        if(LIE1==0) KEYbuf=4;     //如果K5键按下，KEYbuf赋值写4
        else if(LIE2==0) KEYbuf=5; //如果K6键按下，KEYbuf赋值写5
        else if(LIE3==0) KEYbuf=6; //如果K7键按下，KEYbuf赋值写6
        else if(LIE4==0) KEYbuf=7; //如果K8键按下，KEYbuf赋值写7

        P1=0xFB;                  //将第三行置零，以扫描K9-K12是否被按下
        if(LIE1==0) KEYbuf=8;     //如果K9键按下，KEYbuf赋值写8
        else if(LIE2==0) KEYbuf=9; //如果K10键按下，KEYbuf赋值写9
        else if(LIE3==0) KEYbuf=10;//如果K11键按下，KEYbuf赋值写10
        else if(LIE4==0) KEYbuf=11;//如果K12键按下，KEYbuf赋值写11

        P1=0xF7;                  //将第四行置零，以扫描K13-K16是否被按下
        if(LIE1==0) KEYbuf=12;    //如果K13键按下，KEYbuf赋值写12
        else if(LIE2==0) KEYbuf=13;//如果K14键按下，KEYbuf赋值写13
        else if(LIE3==0) KEYbuf=14;//如果K15键按下，KEYbuf赋值写14
        else if(LIE4==0) KEYbuf=15;//如果K16键按下，KEYbuf赋值写15
		  		
    //*********************

    //**给1602显示寄存器赋值(0-255)**
        DISbuf=KEYbuf+1;           //将键值加1送显示
    //*******************************

    //***1602液晶显示0-255***
        LCD1602_Disp(0,0,DISbuf/100+'0');      //在第1行的第1列显示百位
        LCD1602_Disp(1,0,(DISbuf%100)/10+'0'); //在第1行的第2列显示十位
        LCD1602_Disp(2,0,DISbuf%10+'0');       //在第1行的第3列显示个位
    //***********************

    }
}

