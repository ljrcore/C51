////////////////////////////////////////////////////////////////////////////
//                给力者单片机开发学习系统，开发学习都给力！              //
////////////////////////////////////////////////////////////////////////////
//                     学习51单片机，其实可以很简单                       //
////////////////////////////////////////////////////////////////////////////
//                宁波芯动电子有限公司  www.MovingChip.com                //
////////////////////////////////////////////////////////////////////////////

#include <AT89X52.h>       //调用51单片机的头文件

//---------------------------------------
//数码管字形表，供显示时查询
unsigned char code LED[10]=
{                          //定义表格一定要使用code，这样会做到程序存储区中
    0x3F,                  //"0"的字形表，0B00111111
    0x06,                  //"1"的字形表，0B00000110
    0x5B,                  //"2"的字形表，0B01011011
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    0x6F,                  //"9"的字形表，0B01101111
};

//---------------------------------------
//4位数码管相关I/O设置
sbit U16A0=P1^0;           //U16(74HC138)的A0脚接在P1.0口上
sbit U16A1=P1^1;           //U16(74HC138)的A1脚接在P1.1口上
sbit U16A2=P1^2;           //U16(74HC138)的A2脚接在P1.2口上
//---------------------------------------

//---------------------------------------
//名称: 主函数
//适用：给力者GL9单片机开发学习系统
//公司：宁波芯动电子有限公司
//网址：www.MovingChip.com
//日期：20120914
//---------------------------------------
void main(void)            //主函数,单片机开机后就是从这个函数开始运行
{

    unsigned char c=0;     //定义一个char型变量，做延时用
    unsigned char d=0;     //定义一个char型变量，控制显示位置

    while(1)               //死循环,单片机初始化后,将一直运行这个死循环
    {

        for(c=0;c<250;c++);//做一个0-250的循环，不执行其他操作，只为延时
        P2=0;              //关一次显示，以免显示出鬼影
        if(++d>3) d=0;     //先将d加1，然后判断是否大于3，大于3归零
        if(d==0)           //如果d=0,显示千位
        {
            P1=0x03;       //U16A0=1,U16A1=1,U16A2=0选通数码管的千位进行显示
            P2=LED[0];     //千位显示"0"
        }
        else if(d==1)      //如果d=1,显示百位
        {
            P1=0x02;       //U16A0=0,U16A1=1,U16A2=0选通数码管的百位进行显示
            P2=LED[1];     //百位显示"1"
        }
        else if(d==2)      //如果d=2,显示十位
        {
            P1=0x01;       //U16A0=1,U16A1=0,U16A2=0选通数码管的十位进行显示
            P2=LED[2];     //十位显示"2"
        }
        else               //如果d=3,显示个位
        {
            P1=0x00;       //U16A0=0,U16A1=0,U16A2=0选通数码管的个位进行显示
            P2=LED[3];     //个位显示"3"
        }
    }
}

