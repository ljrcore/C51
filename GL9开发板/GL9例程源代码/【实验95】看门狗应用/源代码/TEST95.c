////////////////////////////////////////////////////////////////////////////
//                给力者单片机开发学习系统，开发学习都给力！              //
////////////////////////////////////////////////////////////////////////////
//                     学习51单片机，其实可以很简单                       //
////////////////////////////////////////////////////////////////////////////
//                宁波芯动电子有限公司  www.MovingChip.com                //
////////////////////////////////////////////////////////////////////////////

#include <AT89X52.h>       //调用51单片机的头文件

//新增特殊功能寄存器定义
sfr	 WDT_CONTR	=   0xe1;
//---------------------------------------
//8独立按键相关I/O设置
sbit P1key=P1^0;           //按键P1接在P1.0口上
sbit P2key=P1^1;           //按键P2接在P1.1口上
sbit P3key=P1^2;           //按键P3接在P1.2口上
sbit P4key=P1^3;           //按键P4接在P1.3口上
sbit P5key=P1^4;           //按键P5接在P1.4口上
sbit P6key=P1^5;           //按键P6接在P1.5口上
sbit P7key=P1^6;           //按键P7接在P1.6口上
sbit P8key=P1^7;           //按键P8接在P1.7口上
//---------------------------------------

//---------------------------------------
//1602液晶相关I/O设置
sbit E=P2^3;               //1602液晶的E脚接在P2.3口上
sbit RW=P2^4;              //1602液晶的RW脚接在P2.4口上
sbit RS=P2^5;              //1602液晶的RS脚接在P2.5口上
//---------------------------------------

//---------------------------------------
//名称：1602液晶用延时函数
//适用：给力者GL9单片机开发学习系统
//公司：宁波芯动电子有限公司
//网址：www.MovingChip.com
//日期：20140411
//---------------------------------------
void Delay1602(unsigned int t)
{ 
     unsigned int k;      //定义一个16位寄存器用来做延时用 
     for(k=0;k<t;k++);    //延时 
} 

//---------------------------------------
//名称：1602液晶忙检测函数
//适用：给力者GL9单片机开发学习系统
//公司：宁波芯动电子有限公司
//网址：www.MovingChip.com
//日期：20140411
//---------------------------------------
void LCD1602_busy(void)
{ 
     P0_7=1;              //将P0.7置1，为读状态做准备 
     RS=0;                //RS=0、RW=1、E=1时，忙信号输出到DB7，由P0.7读入
     RW=1;                //RS=0、RW=1、E=1时，忙信号输出到DB7，由P0.7读入
     E=1;                 //RS=0、RW=1、E=1时，忙信号输出到DB7，由P0.7读入
     while(P0_7==1);      //由P0.7读入1，表示1602液晶忙，需要等待
     E=0;                 //读完以后，恢复E的电平
} 

//---------------------------------------
//名称：1600写命令函数
//适用：给力者GL9单片机开发学习系统
//公司：宁波芯动电子有限公司
//网址：www.MovingChip.com
//日期：20140411
//---------------------------------------
void LCD1602_Write_com(unsigned char combuf)
{ 
     RS=0;                //选择指令寄存器
     RW=0;                //选择写状态
     P0=combuf;           //将命令字通过P0口送至DB
     E=1;                 //E高电平将命令字写入1602液晶
     E=0;                 //写完以后，恢复E的电平
} 

//---------------------------------------
//名称：1602写命令函数(带忙检测)
//适用：给力者GL9单片机开发学习系统
//公司：宁波芯动电子有限公司
//网址：www.MovingChip.com
//日期：20140411
//---------------------------------------
void LCD1602_Write_com_busy(unsigned char combuf)
{ 
     LCD1602_busy();            //调用忙检测函数
     LCD1602_Write_com(combuf); //调用忙检测函数
} 

//---------------------------------------
//名称：1602写数据函数(带忙检测)
//适用：给力者GL9单片机开发学习系统
//公司：宁波芯动电子有限公司
//网址：www.MovingChip.com
//日期：20140411
//---------------------------------------
void LCD1602_Write_data_busy(unsigned char databuf)
{ 
     LCD1602_busy();      //调用忙检测函数
     RS=1;                //选择数据寄存器
     RW=0;                //选择写状态
     P0=databuf;          //将命令字通过P0口送至DB
     E=1;                 //E高电平将命令字写入1602液晶
     E=0;                 //写完以后，恢复E的电平
} 

//---------------------------------------
//名称：1602液晶显示地址写函数
//适用：给力者GL9单片机开发学习系统
//公司：宁波芯动电子有限公司
//网址：www.MovingChip.com
//日期：20140411
//---------------------------------------
void LCD1602_Write_address(unsigned char x,unsigned char y)
{ 
     x&=0x0f;             //列地址限制在0-15间
     y&=0x01;             //行地址限制在0-1间
     if(y==0)             //如果是第一行
         LCD1602_Write_com_busy(x|0x80);        //将列地址写入
     else                 //如果是第二行
         LCD1602_Write_com_busy((x+0x40)|0x80); //将列地址写入
} 

//---------------------------------------
//名称：1602液晶初始化函数
//适用：给力者GL9单片机开发学习系统
//公司：宁波芯动电子有限公司
//网址：www.MovingChip.com
//日期：20140411
//---------------------------------------
void LCD1602_init(void)
{ 
     Delay1602(1500);               //调用延时函数
     LCD1602_Write_com(0x38);       //8位数据总线，两行显示模式，5*7点阵显示
     Delay1602(500);                //调用延时函数
     LCD1602_Write_com(0x38);       //8位数据总线，两行显示模式，5*7点阵显示
     Delay1602(500);                //调用延时函数
     LCD1602_Write_com(0x38);       //8位数据总线，两行显示模式，5*7点阵显示
     LCD1602_Write_com_busy(0x38);  //8位数据总线，两行显示模式，5*7点阵显示
     LCD1602_Write_com_busy(0x08);  //显示功能关，无光标
     LCD1602_Write_com_busy(0x01);  //清屏
     LCD1602_Write_com_busy(0x06);  //写入新的数据后，光标右移，显示屏不移动
     LCD1602_Write_com_busy(0x0C);  //显示功能开，无光标
} 

//---------------------------------------
//名称：1602液晶指定地址显示函数
//适用：给力者GL9单片机开发学习系统
//公司：宁波芯动电子有限公司
//网址：www.MovingChip.com
//日期：20140411
//---------------------------------------
void LCD1602_Disp(unsigned char x,unsigned char y,unsigned char buf)
{ 
     LCD1602_Write_address(x,y);    //先将地址信息写入
     LCD1602_Write_data_busy(buf);  //再写入要显示的数据
} 

//---------------------------------------
//名称: 主函数
//适用：给力者GL9单片机开发学习系统
//公司：宁波芯动电子有限公司
//网址：www.MovingChip.com
//日期：20140411
//---------------------------------------
void main(void)            //主函数,单片机开机后就是从这个函数开始运行
{
    LCD1602_init();        //调用1602液晶初始化函数
	LCD1602_Disp(0,0,'B');      //在第1行的第1列显示B
    LCD1602_Disp(1,0,'o');      //在第1行的第2列显示o
	LCD1602_Disp(2,0,'o');      //在第1行的第3列显示o
	LCD1602_Disp(3,0,'t');      //在第1行的第4列显示t
	LCD1602_Disp(4,0,'i');      //在第1行的第5列显示i
	LCD1602_Disp(5,0,'n');      //在第1行的第6列显示n
	LCD1602_Disp(6,0,'g');      //在第1行的第7列显示g
	LCD1602_Disp(7,0,'.');      //在第1行的第8列显示.
	LCD1602_Disp(8,0,'.');      //在第1行的第9列显示.
	LCD1602_Disp(9,0,'.');      //在第1行的第10列显示.
	WDT_CONTR=0x3f;   
	//12时钟模式，看门狗溢出时间=（12*Pre_scale*32768）/22118400
	//=Pre_scale*393216/22118400
	//设置为256分频，看门狗溢出时间为4.5511秒
    while(1)               		//死循环,单片机初始化后,将一直运行这个死循环
    {
   		WDT_CONTR=0x3f;         //在正常的路途中，设置喂狗程序
        	if(P1key==0)      		//如果P1键按下,人为制造一个死循环
			{
				LCD1602_Disp(0,0,'C');      //在第1行的第1列显示C
    			LCD1602_Disp(1,0,'P');      //在第1行的第2列显示P
				LCD1602_Disp(2,0,'U');      //在第1行的第3列显示U
				LCD1602_Disp(3,0,' ');      //在第1行的第4列显示""
				LCD1602_Disp(4,0,'i');      //在第1行的第5列显示i
				LCD1602_Disp(5,0,'s');      //在第1行的第6列显示s
				LCD1602_Disp(6,0,' ');      //在第1行的第7列显示""
				LCD1602_Disp(7,0,'d');      //在第1行的第8列显示d
				LCD1602_Disp(8,0,'e');      //在第1行的第9列显示e
				LCD1602_Disp(9,0,'a');      //在第1行的第10列显示a
				LCD1602_Disp(10,0,'d');      //在第1行的第11列显示d
				while(1);           				//程序运行到这将死在这里，逼迫看门狗起作用
		}
    }
}
//实验说明：
//插上1602液晶
//插上8P杜邦线一条于CN6-CN32之间
//按P1键将使CPU进入死循环,以观察看门狗是否起作用
