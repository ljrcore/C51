/*************************************************************************************
*  标题:  步进电机试验三（加减速运行）												 *
* 																					 *
*    通过本例程了解步进马达使用及驱动程序编写										 *
*;   单双八拍工作方式：                                                          	 *
*;   A-AB-B-BC-C-CD-D-DA (即一个脉冲,转 3.75 度)      								 *
*                     	                                                       		 *
*  请学员一定要消化掉本例程															 *
**************************************************************************************/

 
 #include "reg52.h"

 void delay();

 //Motor
sbit F1 = P1^0;
sbit F2 = P1^1;
sbit F3 = P1^2;
sbit F4 = P1^3;

unsigned char code FFW[8]={0xf1,0xf3,0xf2,0xf6,0xf4,0xfc,0xf8,0xf9}; //反转
unsigned char code FFZ[8]={0xf9,0xf8,0xfc,0xf4,0xf6,0xf2,0xf3,0xf1}; //正转
unsigned int  K, rate;


/**********************************************************
*														  *
*                 步进电机驱动							  *
***********************************************************/
void  motor_ffw()
 { 
   unsigned char i;

      for (i=0; i<8; i++)       //一个周期转30度
        {
          P1 = FFW[i]&0x1f;  //取数据
		
          delay();           //调节转速
        }
     } 

/********************************************
	 延时程序
*********************************************/

 void delay()   
{                           
   unsigned int k,t;
    t=rate;
   while(t--)
   {
     for(k=0; k<100; k++)
     { }
   }
}


/********************************************************
*                                                       
*步进电机运行                                               
*                                                      
*********************************************************/
void  motor_turn()
{ 
   unsigned char x;
   rate=0x2a;
   x=0x40;
   do
     {
	  motor_ffw();          //加速
      rate--;
	 }while(rate!=0x08);
   do
     { 	   
	   motor_ffw();        //匀速
	   x--;
	 }while(x!=0x01);
	 
   do
     {
	  motor_ffw();         //减速
      rate++;
	 }while(rate!=0x2a);    
}

main() 
 { 
    while(1)
	{
	
	 motor_turn();
	

	 }
}

