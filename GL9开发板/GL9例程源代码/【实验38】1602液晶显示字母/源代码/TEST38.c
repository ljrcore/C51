

#include <AT89X52.h>       //调用51单片机的头文件

//---------------------------------------
//1602液晶相关I/O设置
sbit E=P2^3;               //1602液晶的E脚接在P2.3口上
sbit RW=P2^4;              //1602液晶的RW脚接在P2.4口上
sbit RS=P2^5;              //1602液晶的RS脚接在P2.5口上
//---------------------------------------
//---------------------------------------
void Delay1602(unsigned int t)
{ 
     unsigned int k;      //定义一个16位寄存器用来做延时用 
     for(k=0;k<t;k++);    //延时 
} 

//---------------------------------------
//名称：1602液晶忙检测函数
//---------------------------------------
void LCD1602_busy(void)
{ 
     P0_7=1;              //将P0.7置1，为读状态做准备 
     RS=0;                //RS=0、RW=1、E=1时，忙信号输出到DB7，由P0.7读入
     RW=1;                //RS=0、RW=1、E=1时，忙信号输出到DB7，由P0.7读入
     E=1;                 //RS=0、RW=1、E=1时，忙信号输出到DB7，由P0.7读入
     while(P0_7==1);      //由P0.7读入1，表示1602液晶忙，需要等待
     E=0;                 //读完以后，恢复E的电平
} 

//---------------------------------------
//名称：1600写命令函数
//---------------------------------------
void LCD1602_Write_com(unsigned char combuf)
{ 
     RS=0;                //选择指令寄存器
     RW=0;                //选择写状态
     P0=combuf;           //将命令字通过P0口送至DB
     E=1;                 //E高电平将命令字写入1602液晶
     E=0;                 //写完以后，恢复E的电平
} 

//---------------------------------------
//名称：1602写命令函数(带忙检测)
//---------------------------------------
void LCD1602_Write_com_busy(unsigned char combuf)
{ 
     LCD1602_busy();            //调用忙检测函数
     LCD1602_Write_com(combuf); //调用忙检测函数
} 

//---------------------------------------
//名称：1602写数据函数(带忙检测)
//---------------------------------------
void LCD1602_Write_data_busy(unsigned char databuf)
{ 
     LCD1602_busy();      //调用忙检测函数
     RS=1;                //选择数据寄存器
     RW=0;                //选择写状态
     P0=databuf;          //将命令字通过P0口送至DB
     E=1;                 //E高电平将命令字写入1602液晶
     E=0;                 //写完以后，恢复E的电平
} 

//---------------------------------------
//名称：1602液晶显示地址写函数
//---------------------------------------
void LCD1602_Write_address(unsigned char x,unsigned char y)
{ 
     x&=0x0f;             //列地址限制在0-15间
     y&=0x01;             //行地址限制在0-1间
     if(y==0)             //如果是第一行
         LCD1602_Write_com_busy(x|0x80);        //将列地址写入
     else                 //如果是第二行
         LCD1602_Write_com_busy((x+0x40)|0x80); //将列地址写入
} 

//---------------------------------------
//名称：1602液晶初始化函数
//---------------------------------------
void LCD1602_init(void)
{ 
     Delay1602(1500);               //调用延时函数
     LCD1602_Write_com(0x38);       //8位数据总线，两行显示模式，5*7点阵显示
     Delay1602(500);                //调用延时函数
     LCD1602_Write_com(0x38);       //8位数据总线，两行显示模式，5*7点阵显示
     Delay1602(500);                //调用延时函数
     LCD1602_Write_com(0x38);       //8位数据总线，两行显示模式，5*7点阵显示
     LCD1602_Write_com_busy(0x38);  //8位数据总线，两行显示模式，5*7点阵显示
     LCD1602_Write_com_busy(0x08);  //显示功能关，无光标
     LCD1602_Write_com_busy(0x01);  //清屏
     LCD1602_Write_com_busy(0x06);  //写入新的数据后，光标右移，显示屏不移动
     LCD1602_Write_com_busy(0x0C);  //显示功能开，无光标
} 

//---------------------------------------
//名称：1602液晶指定地址显示函数
//---------------------------------------
void LCD1602_Disp(unsigned char x,unsigned char y,unsigned char buf)
{ 
     LCD1602_Write_address(x,y);    //先将地址信息写入
     LCD1602_Write_data_busy(buf);  //再写入要显示的数据
} 

//---------------------------------------
//名称: 主函数
//---------------------------------------
void main(void)            //主函数,单片机开机后就是从这个函数开始运行
{

    LCD1602_init();        //调用1602液晶初始化函数

    //****1602液晶第1行显示"ABCDEFGHIJKLMNOP"****
    //****1602液晶第2行显示"abcdefghijklmnop"****
    LCD1602_Disp(0,0,'A');     //在第1行的第1列显示A
    LCD1602_Disp(1,0,'B');     //在第1行的第2列显示B
    LCD1602_Disp(2,0,'C');     //在第1行的第3列显示C
    LCD1602_Disp(3,0,'D');     //在第1行的第4列显示D
    LCD1602_Disp(4,0,'E');     //在第1行的第5列显示E
    LCD1602_Disp(5,0,'F');     //在第1行的第6列显示F
    LCD1602_Disp(6,0,'G');     //在第1行的第7列显示G
    LCD1602_Disp(7,0,'H');     //在第1行的第8列显示H
    LCD1602_Disp(8,0,'I');     //在第1行的第9列显示I
    LCD1602_Disp(9,0,'J');     //在第1行的第10列显示J
    LCD1602_Disp(10,0,'K');    //在第1行的第11列显示K
    LCD1602_Disp(11,0,'L');    //在第1行的第12列显示L
    LCD1602_Disp(12,0,'M');    //在第1行的第13列显示M
    LCD1602_Disp(13,0,'N');    //在第1行的第14列显示N
    LCD1602_Disp(14,0,'O');    //在第1行的第15列显示O
    LCD1602_Disp(15,0,'P');    //在第1行的第16列显示P
    LCD1602_Disp(0,1,'a');     //在第2行的第1列显示a
    LCD1602_Disp(1,1,'b');     //在第2行的第2列显示b
    LCD1602_Disp(2,1,'c');     //在第2行的第3列显示c
    LCD1602_Disp(3,1,'d');     //在第2行的第4列显示d
    LCD1602_Disp(4,1,'e');     //在第2行的第5列显示e
    LCD1602_Disp(5,1,'f');     //在第2行的第6列显示f
    LCD1602_Disp(6,1,'g');     //在第2行的第7列显示g
    LCD1602_Disp(7,1,'h');     //在第2行的第8列显示h
    LCD1602_Disp(8,1,'i');     //在第2行的第9列显示i
    LCD1602_Disp(9,1,'j');     //在第2行的第10列显示j
    LCD1602_Disp(10,1,'k');    //在第2行的第11列显示k
    LCD1602_Disp(11,1,'l');    //在第2行的第12列显示l
    LCD1602_Disp(12,1,'m');    //在第2行的第13列显示m
    LCD1602_Disp(13,1,'n');    //在第2行的第14列显示n
    LCD1602_Disp(14,1,'o');    //在第2行的第15列显示o
    LCD1602_Disp(15,1,'p');    //在第2行的第16列显示p
    //************************

    while(1)               //死循环,单片机初始化后,将一直运行这个死循环
    {

    }
}

