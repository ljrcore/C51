////////////////////////////////////////////////////////////////////////////
//                给力者单片机开发学习系统，开发学习都给力！              //
////////////////////////////////////////////////////////////////////////////
//                     学习51单片机，其实可以很简单                       //
////////////////////////////////////////////////////////////////////////////
//                宁波芯动电子有限公司  www.MovingChip.com                //
////////////////////////////////////////////////////////////////////////////

#include <AT89X52.h>       //调用51单片机的头文件
#include <Intrins.h>    //因为本例中用到空操作_nop_();所以必须调用这个头文件

//---------------------------------------
//12864液晶相关I/O设置
sbit RS=P2^0; 			//寄存器选择端 H:数据寄存器，L:命令寄存器
sbit RW=P2^1; 			//读/写选择信号，R/W=1：读选通，R/W=0：写选通
sbit E =P2^2; 			//读写使能信号，在E下降沿，数据被锁存(写)入,在E高电平器件，数据被读出
sbit CS1=P2^3; 			//前64点选择，1有效
sbit CS2=P2^4; 			//后64点选择，1有效
sbit RST=P2^5; 			//复位信号
sbit DB0=P0^7; 			//
sbit DB1=P0^6; 			//
sbit DB2=P0^5; 			//
sbit DB3=P0^4; 			//
sbit DB4=P0^3; 			//
sbit DB5=P0^2; 			//
sbit DB6=P0^1; 			//
sbit DB7=P0^0; 			//
//---------------------------------------

//用取模软件将要显示图片的数据提出来
unsigned char code picture[]={
/*--  调入了一幅图像：I:\单片机工具\取字模软件\BMP图片\位图(1bit)\05.bmp  --*/
/*--  宽度x高度=128x64  --*/
0x00,0x40,0x04,0x00,0x00,0x00,0x00,0x40,0x00,0x00,0x00,0x00,0x00,0x02,0x01,0x00,
0x0B,0x00,0x04,0x02,0x04,0x02,0x00,0x00,0x00,0x06,0x01,0x06,0x01,0x04,0x7D,0x54,
0xFB,0x7A,0xA8,0x59,0xA0,0x00,0x00,0x01,0x20,0x40,0x20,0x59,0xAC,0x53,0xAE,0xD1,
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0x1C,0xF6,0x76,0xBB,0x64,0x19,0x35,0x00,0x11,0x09,0x2C,0x03,0x00,0x00,0x00,0x00,
};
//---------------------------------------
//名称：液晶用延时函数
//适用：给力者GL9单片机开发学习系统
//公司：宁波芯动电子有限公司
//网址：www.MovingChip.com
//日期：20120918
//---------------------------------------
void delay(unsigned int t)
{
	unsigned int i;
	for(i=0;i<t;i++);	
}
//---------------------------------------
//名称：字节内位数据位置转换函数
//适用：给力者GL9单片机开发学习系统
//公司：宁波芯动电子有限公司
//网址：www.MovingChip.com
//日期：20120918
//---------------------------------------
unsigned char num(unsigned char dat)
{
   unsigned char val;
	val = ((dat & 0x01) << 7) | ((dat & 0x02) << 5) | ((dat & 0x04) << 3) | ((dat & 0x08) << 1) |
   ((dat & 0x10) >> 1) | ((dat & 0x20) >> 3) | ((dat & 0x40) >> 5) | ((dat & 0x80) >> 7);
   return  val;
} 
//---------------------------------------
//名称：写命令函数
//适用：给力者GL9单片机开发学习系统
//公司：宁波芯动电子有限公司
//网址：www.MovingChip.com
//日期：20120918
//---------------------------------------
void write_com(unsigned char cmdcode)
{					   
	RS=0;				//选择命令寄存器
	RW=0; 				//写选通
	P0=num(cmdcode);    //将命令写入总线
	_nop_();            //空操作，做短暂的延时
	E=1;            	//E的下降沿，数据写入
	_nop_();            //空操作，做短暂的延时
	E=0;            	//E的下降沿，数据写入
}
//---------------------------------------
//名称：写数据函数
//适用：给力者GL9单片机开发学习系统
//公司：宁波芯动电子有限公司
//网址：www.MovingChip.com
//日期：20120918
//---------------------------------------
void write_data(unsigned char Rsspdata)
{

	RS=1;				//选择数据寄存器
	RW=0; 				//写选通
	P0=num(Rsspdata);   //将数据写入总线
	_nop_();            //空操作，做短暂的延时
	E=1;            	//E的下降沿，数据写入
	_nop_();            //空操作，做短暂的延时
	E=0;            	//E的下降沿，数据写入
} 
//---------------------------------------
//名称：清屏函数
//适用：给力者GL9单片机开发学习系统
//公司：宁波芯动电子有限公司
//网址：www.MovingChip.com
//日期：20120918
//---------------------------------------
void Clr_Scr(void)
{
	unsigned char j,k;
	CS1=1;     						//左半屏选通
	CS2=1;     						//右半屏选通
	write_com(0x40+0);         //将列地址写入  
		//列地址格式为: 0 1 C5 C4 C3 C2 C1 C0,其中C5-C0=0~0x3f
		//分别代表1~64列
	for(k=0;k<8;k++)
	{
		write_com(0xb8+k);     //将行地址写入	
		//行地址格式为: 1 0 1 1 1 P2 P1 P0,其中P3-C0=0~0x07
		//分别代表1~8行

		for(j=0;j<64;j++) 		//每行的64列都写0，因为选了左右两屏，
		{
			write_data(0x00);  	//64列同时写0
		}
	}
} 
//---------------------------------------
//名称：地址写入函数
//适用：给力者GL9单片机开发学习系统
//公司：宁波芯动电子有限公司
//网址：www.MovingChip.com
//日期：20120918
//---------------------------------------
void werite_x_y(unsigned char x,unsigned char y)
{
	y=y&0x7f;     				  //限定范围，列不能超过128
	x=x&0x07;     				  //限定范围，行不能超过8
	if(y<64)                  //如果列小于64
	{
		CS1=1;                 //选通左半屏
		CS2=0;                 //关闭右半屏
		write_com(0x40+y);     //将列地址写入  
		//列地址格式为: 0 1 C5 C4 C3 C2 C1 C0,其中C5-C0=0~0x3f
		//分别代表1~64列
	}
	else
	{
		CS1=0;                 //关闭左半屏
		CS2=1;                 //选通右半屏
		y&=0x3f;
		write_com(0x40+y);     //将列地址写入  
		//列地址格式为: 0 1 C5 C4 C3 C2 C1 C0,其中C5-C0=0~0x3f
		//分别代表1~64列	
	}
	write_com(0xb8+x);     //将行地址写入	
		//行地址格式为: 1 0 1 1 1 P2 P1 P0,其中P3-C0=0~0x07
		//分别代表1~8行
} 

//---------------------------------------
//名称：全屏写图片函数
//适用：给力者GL9单片机开发学习系统
//公司：宁波芯动电子有限公司
//网址：www.MovingChip.com
//日期：20120918
//---------------------------------------
void write_bmp(void)
{
	unsigned char j=0,i=0;	
	for(j=0;j<8;j++)
	{
		werite_x_y(j,0);
		for(i=0;i<64;i++) write_data(picture[j*128+i]);
		werite_x_y(j,64);
		for(i=64;i<128;i++) write_data(picture[j*128+i]);
	}
}
//---------------------------------------
//名称：12864初始化函数
//适用：给力者GL9单片机开发学习系统
//公司：宁波芯动电子有限公司
//网址：www.MovingChip.com
//日期：20120918
//--------------------------------------- 
void init_lcd(void)
{	   
	RST=0;                 //液晶复位
	delay(250);            //适当延时
	RST=1;                 //复位结束
	CS1=1;     				  //左半屏选通
	CS2=1;     				  //右半屏选通	
	delay(250);            //适当延时
	write_com(0x3f);       //显示开
}  
//---------------------------------------
//名称: 主函数
//适用：给力者GL9单片机开发学习系统
//公司：宁波芯动电子有限公司
//网址：www.MovingChip.com
//日期：20120918
//---------------------------------------	
void main()
{  
	init_lcd();					  //初始化液晶
  	Clr_Scr();					  //清屏  
	write_bmp();            //调用图片写函数
	while(1)
	{		   	
		
	}
}

