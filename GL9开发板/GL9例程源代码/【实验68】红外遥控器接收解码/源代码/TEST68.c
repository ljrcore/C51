////////////////////////////////////////////////////////////////////////////
//                给力者单片机开发学习系统，开发学习都给力！              //
////////////////////////////////////////////////////////////////////////////
//                     学习51单片机，其实可以很简单                       //
////////////////////////////////////////////////////////////////////////////
//                宁波芯动电子有限公司  www.MovingChip.com                //
////////////////////////////////////////////////////////////////////////////

#include <AT89X52.h>       //调用51单片机的头文件

//---------------------------------------
//1602液晶相关I/O设置
sbit E=P2^3;               //1602液晶的E脚接在P2.3口上
sbit RW=P2^4;              //1602液晶的RW脚接在P2.4口上
sbit RS=P2^5;              //1602液晶的RS脚接在P2.5口上
//---------------------------------------

//---------------------------------------
//1602液晶寄存器设置
unsigned char DISbuf;     //设置8位的unsigend char型寄存器用来暂存1602要显示的内容
unsigned char j;          //设置8位的unsigend char型寄存器用来暂存转换数据
//---------------------------------------
		 
//---------------------------------------
//红外接收解码寄存器设置
unsigned char address;
unsigned char shuju;
unsigned char tmr_times;
unsigned char int_times;
unsigned char code_data;
unsigned char code_data1;
unsigned int beepcon;
bit flagf;
bit head_ok;
bit lanth;
//---------------------------------------

//---------------------------------------
//名称：1602液晶用延时函数
//适用：给力者GL9单片机开发学习系统
//公司：宁波芯动电子有限公司
//网址：www.MovingChip.com
//日期：20120916
//---------------------------------------
void Delay1602(unsigned int t)
{ 
     unsigned int k;      //定义一个16位寄存器用来做延时用 
     for(k=0;k<t;k++);    //延时 
} 

//---------------------------------------
//名称：1602液晶忙检测函数
//适用：给力者GL9单片机开发学习系统
//公司：宁波芯动电子有限公司
//网址：www.MovingChip.com
//日期：20120916
//---------------------------------------
void LCD1602_busy(void)
{ 
     P0_7=1;              //将P0.7置1，为读状态做准备 
     RS=0;                //RS=0、RW=1、E=1时，忙信号输出到DB7，由P0.7读入
     RW=1;                //RS=0、RW=1、E=1时，忙信号输出到DB7，由P0.7读入
     E=1;                 //RS=0、RW=1、E=1时，忙信号输出到DB7，由P0.7读入
     while(P0_7==1);      //由P0.7读入1，表示1602液晶忙，需要等待
     E=0;                 //读完以后，恢复E的电平
} 

//---------------------------------------
//名称：1600写命令函数
//适用：给力者GL9单片机开发学习系统
//公司：宁波芯动电子有限公司
//网址：www.MovingChip.com
//日期：20120916
//---------------------------------------
void LCD1602_Write_com(unsigned char combuf)
{ 
     RS=0;                //选择指令寄存器
     RW=0;                //选择写状态
     P0=combuf;           //将命令字通过P0口送至DB
     E=1;                 //E高电平将命令字写入1602液晶
     E=0;                 //写完以后，恢复E的电平
} 

//---------------------------------------
//名称：1602写命令函数(带忙检测)
//适用：给力者GL9单片机开发学习系统
//公司：宁波芯动电子有限公司
//网址：www.MovingChip.com
//日期：20120916
//---------------------------------------
void LCD1602_Write_com_busy(unsigned char combuf)
{ 
     LCD1602_busy();            //调用忙检测函数
     LCD1602_Write_com(combuf); //调用忙检测函数
} 

//---------------------------------------
//名称：1602写数据函数(带忙检测)
//适用：给力者GL9单片机开发学习系统
//公司：宁波芯动电子有限公司
//网址：www.MovingChip.com
//日期：20120916
//---------------------------------------
void LCD1602_Write_data_busy(unsigned char databuf)
{ 
     LCD1602_busy();      //调用忙检测函数
     RS=1;                //选择数据寄存器
     RW=0;                //选择写状态
     P0=databuf;          //将命令字通过P0口送至DB
     E=1;                 //E高电平将命令字写入1602液晶
     E=0;                 //写完以后，恢复E的电平
} 

//---------------------------------------
//名称：1602液晶显示地址写函数
//适用：给力者GL9单片机开发学习系统
//公司：宁波芯动电子有限公司
//网址：www.MovingChip.com
//日期：20120916
//---------------------------------------
void LCD1602_Write_address(unsigned char x,unsigned char y)
{ 
     x&=0x0f;             //列地址限制在0-15间
     y&=0x01;             //行地址限制在0-1间
     if(y==0)             //如果是第一行
         LCD1602_Write_com_busy(x|0x80);        //将列地址写入
     else                 //如果是第二行
         LCD1602_Write_com_busy((x+0x40)|0x80); //将列地址写入
} 

//---------------------------------------
//名称：1602液晶初始化函数
//适用：给力者GL9单片机开发学习系统
//公司：宁波芯动电子有限公司
//网址：www.MovingChip.com
//日期：20120916
//---------------------------------------
void LCD1602_init(void)
{ 
     Delay1602(1500);               //调用延时函数
     LCD1602_Write_com(0x38);       //8位数据总线，两行显示模式，5*7点阵显示
     Delay1602(500);                //调用延时函数
     LCD1602_Write_com(0x38);       //8位数据总线，两行显示模式，5*7点阵显示
     Delay1602(500);                //调用延时函数
     LCD1602_Write_com(0x38);       //8位数据总线，两行显示模式，5*7点阵显示
     LCD1602_Write_com_busy(0x38);  //8位数据总线，两行显示模式，5*7点阵显示
     LCD1602_Write_com_busy(0x08);  //显示功能关，无光标
     LCD1602_Write_com_busy(0x01);  //清屏
     LCD1602_Write_com_busy(0x06);  //写入新的数据后，光标右移，显示屏不移动
     LCD1602_Write_com_busy(0x0C);  //显示功能开，无光标
} 

//---------------------------------------
//名称：1602液晶指定地址显示函数
//适用：给力者GL9单片机开发学习系统
//公司：宁波芯动电子有限公司
//网址：www.MovingChip.com
//日期：20120916
//---------------------------------------
void LCD1602_Disp(unsigned char x,unsigned char y,unsigned char buf)
{ 
     LCD1602_Write_address(x,y);    //先将地址信息写入
     LCD1602_Write_data_busy(buf);  //再写入要显示的数据
} 

//---------------------------------------
//名称: 错误处理函数
//适用：给力者GL9单片机开发学习系统
//公司：宁波芯动电子有限公司
//网址：www.MovingChip.com
//日期：20120916
//---------------------------------------
void wrong()
{
  	int_times=0;
  	tmr_times=0;
  	head_ok=0;
  	code_data=0;
  	lanth=0;
  	flagf=0;
}

//---------------------------------------
//名称: 一零判断函数
//适用：给力者GL9单片机开发学习系统
//公司：宁波芯动电子有限公司
//网址：www.MovingChip.com
//日期：20120916
//---------------------------------------
void one_zero()
{
  	lanth=0;
  	if((tmr_times>2)&(tmr_times<7))
  	{
    	lanth=0;
  	}
  	else if((tmr_times>7)&(tmr_times<13))
  	{
    	lanth=1;
  	}
}

//---------------------------------------
//名称：定时器0中断服务程序
//适用：给力者GL9单片机开发学习系统
//公司：宁波芯动电子有限公司
//网址：www.MovingChip.com
//日期：20120916
//---------------------------------------
void Timer0(void) interrupt 1 
{                          //定时250微秒
    TL0=0x33;              //重新给TL0赋初值
    TH0=0xFE;              //重新给TH0赋初值

    //***此处用户自行添加定时器T0中断处理程序***
	tmr_times++; 
    //******************************************
}

//---------------------------------------
//名称：外部INT1中断服务程序
//适用：给力者GL9单片机开发学习系统
//公司：宁波芯动电子有限公司
//网址：www.MovingChip.com
//日期：20120916
//---------------------------------------
void INIT1(void) interrupt 2 
{

    //***此处用户自行添加外部INT1中断处理程序***
	EA=0;
  	TH0=0xfe;
	TL0=0x33;	    	
  	int_times++;
  	if(head_ok==0)
  	{
    	if(tmr_times>0x31&tmr_times<0x37)	  	
    	{
    		head_ok=1;
    		int_times=0;
    		tmr_times=0;
    		lanth=0;        			        
    	}
    	else
    	{
    		wrong();
    	}
  	}
  	else
  	{    
    	one_zero();
    	code_data=code_data>>1;
    	if(lanth==1)
    	{
    		code_data|=0x80;
    	}
    	else
    	{
    		code_data&=0x7f;
    	}
    	tmr_times=0;
    	lanth=0;       		
    	if(int_times==8)
    	{
       		address=code_data;	 
		}
    	else if(int_times==16)
    	{
       		if(code_data+address!=0xff) wrong();
		}
    	else if(int_times==24)
    	{
    		code_data1=code_data;
    	}
    	else if(int_times==32)
    	{
    		int_times=0;
    		head_ok=0;      
    		if(code_data1==~code_data)
    		{
       			flagf=1;
	 			shuju=code_data1;	
			}
    		else
    		{
       			flagf=0;
    		}
    	}
  	}   
  	EA=1;      	
    //******************************************
}
//---------------------------------------
//名称: 主函数
//适用：给力者GL9单片机开发学习系统
//公司：宁波芯动电子有限公司
//网址：www.MovingChip.com
//日期：20120916
//---------------------------------------	
void main(void)            //主函数,单片机开机后就是从这个函数开始运行
{   

    //***定时器Timer0初始化***
    TMOD&=0xF0;            //将TMOD的低4位定时器0控制部分清零
    TMOD|=0x01;            //设置定时器0为方式1
    TL0=0x33;              //设置定时器0初值低8位
    TH0=0xFE;              //设置定时器0初值高8位
    TR0=1;                 //启动定时器0
    ET0=1;                 //Timer0中断允许
    //**********************

    //***外部中断INT1初始化***
    IT1=1;                 //下降沿触发方式
    EX1=1;                 //外部INT1中断允许
    //**********************
 //***开全局中断设置****
    //定时器Timer0设置了中断允许,此处要开全局中断
    //外部中断INT1设置了中断允许,此处要开全局中断
    EA=1;                  //开全局中断
    //*********************     

	LCD1602_init();        //调用1602液晶初始化函数

    while(1)               //死循环,单片机初始化后,将一直运行这个死循环
	 {
		if(flagf)                //接收到有效数据标志位，注意要人工清除标志位
		{
			flagf=0;				
			//**给1602显示寄存器赋值(0x00-0xFF)**
        DISbuf=shuju;           //
    //***********************************

    //***1602液晶显示0x00-0xFF***
        LCD1602_Disp(0,0,'0');      //在第1行的第1列显示0
        LCD1602_Disp(1,0,'x');      //在第1行的第2列显示x
        j=DISbuf>>4;                //把要显示内容的高4位移到低4位上
        if(j<10)                    //0-F在ASCII码中并不连续，所以要分开处理
        {
            j+='0';                 //0-9的数据以0为基点进行偏移即可
        }
        else
        {
            j=j-10+'A';             //A-F的数据以A为基点进行偏移即可
        }
        LCD1602_Disp(2,0,j);        //在第1行的第3列显示高4位的十六进制数字
        j=DISbuf&0x0F;              //把要显示内容的高4位屏蔽掉，保留低4位
        if(j<10)                    //0-F在ASCII码中并不连续，所以要分开处理
        {
            j+='0';                 //0-9的数据以0为基点进行偏移即可
        }
        else
        {
            j=j-10+'A';             //A-F的数据以A为基点进行偏移即可
        }
        LCD1602_Disp(3,0,j);        //在第1行的第4列显示低4位的十六进制数字
    //***********************
	  }
	}
}

