////////////////////////////////////////////////////////////////////////////
//                给力者单片机开发学习系统，开发学习都给力！              //
////////////////////////////////////////////////////////////////////////////
//                     学习51单片机，其实可以很简单                       //
////////////////////////////////////////////////////////////////////////////
//                宁波芯动电子有限公司  www.MovingChip.com                //
////////////////////////////////////////////////////////////////////////////

#include <AT89X52.h>       //调用51单片机的头文件
#include <Intrins.h> 
//---------------------------------------
//1602液晶相关I/O设置
sbit E=P2^3;               //1602液晶的E脚接在P2.3口上
sbit RW=P2^4;              //1602液晶的RW脚接在P2.4口上
sbit RS=P2^5;              //1602液晶的RS脚接在P2.5口上
//---------------------------------------
unsigned int  Timeout;
unsigned char RH_H;
unsigned char RH_L;
unsigned char T_H;
unsigned char T_L;
unsigned char Checkdata;
//---------------------------------------
//名称：延时函数
//适用：给力者GL9单片机开发学习系统
//公司：宁波芯动电子有限公司
//网址：www.MovingChip.com
//日期：20130702
//---------------------------------------
void Delay(unsigned int j) 
{ 
	unsigned char i;
   for(;j>0;j--)
	{ 	
		for(i=0;i<54;i++);
	}
}

//---------------------------------------
//名称：1602液晶忙检测函数
//适用：给力者GL9单片机开发学习系统
//公司：宁波芯动电子有限公司
//网址：www.MovingChip.com
//日期：20130702
//---------------------------------------
void LCD1602_busy(void)
{ 
     P0_7=1;              //将P0.7置1，为读状态做准备 
     RS=0;                //RS=0、RW=1、E=1时，忙信号输出到DB7，由P0.7读入
     RW=1;                //RS=0、RW=1、E=1时，忙信号输出到DB7，由P0.7读入
     E=1;                 //RS=0、RW=1、E=1时，忙信号输出到DB7，由P0.7读入
     while(P0_7==1);      //由P0.7读入1，表示1602液晶忙，需要等待
     E=0;                 //读完以后，恢复E的电平
} 

//---------------------------------------
//名称：1600写命令函数
//适用：给力者GL9单片机开发学习系统
//公司：宁波芯动电子有限公司
//网址：www.MovingChip.com
//日期：20130702
//---------------------------------------
void LCD1602_Write_com(unsigned char combuf)
{ 
     RS=0;                //选择指令寄存器
     RW=0;                //选择写状态
     P0=combuf;           //将命令字通过P0口送至DB
     E=1;                 //E高电平将命令字写入1602液晶
     E=0;                 //写完以后，恢复E的电平
} 

//---------------------------------------
//名称：1602写命令函数(带忙检测)
//适用：给力者GL9单片机开发学习系统
//公司：宁波芯动电子有限公司
//网址：www.MovingChip.com
//日期：20130702
//---------------------------------------
void LCD1602_Write_com_busy(unsigned char combuf)
{ 
     LCD1602_busy();            //调用忙检测函数
     LCD1602_Write_com(combuf); //调用忙检测函数
} 

//---------------------------------------
//名称：1602写数据函数(带忙检测)
//适用：给力者GL9单片机开发学习系统
//公司：宁波芯动电子有限公司
//网址：www.MovingChip.com
//日期：20130702
//---------------------------------------
void LCD1602_Write_data_busy(unsigned char databuf)
{ 
     LCD1602_busy();      //调用忙检测函数
     RS=1;                //选择数据寄存器
     RW=0;                //选择写状态
     P0=databuf;          //将命令字通过P0口送至DB
     E=1;                 //E高电平将命令字写入1602液晶
     E=0;                 //写完以后，恢复E的电平
} 

//---------------------------------------
//名称：1602液晶显示地址写函数
//适用：给力者GL9单片机开发学习系统
//公司：宁波芯动电子有限公司
//网址：www.MovingChip.com
//日期：20130702
//---------------------------------------
void LCD1602_Write_address(unsigned char x,unsigned char y)
{ 
     x&=0x0f;             //列地址限制在0-15间
     y&=0x01;             //行地址限制在0-1间
     if(y==0)             //如果是第一行
         LCD1602_Write_com_busy(x|0x80);        //将列地址写入
     else                 //如果是第二行
         LCD1602_Write_com_busy((x+0x40)|0x80); //将列地址写入
} 

//---------------------------------------
//名称：1602液晶初始化函数
//适用：给力者GL9单片机开发学习系统
//公司：宁波芯动电子有限公司
//网址：www.MovingChip.com
//日期：20130702
//---------------------------------------
void LCD1602_init(void)
{ 
     Delay(150);               //调用延时函数
     LCD1602_Write_com(0x38);       //8位数据总线，两行显示模式，5*7点阵显示
     Delay(50);                //调用延时函数
     LCD1602_Write_com(0x38);       //8位数据总线，两行显示模式，5*7点阵显示
     Delay(50);                //调用延时函数
     LCD1602_Write_com(0x38);       //8位数据总线，两行显示模式，5*7点阵显示
     LCD1602_Write_com_busy(0x38);  //8位数据总线，两行显示模式，5*7点阵显示
     LCD1602_Write_com_busy(0x08);  //显示功能关，无光标
     LCD1602_Write_com_busy(0x01);  //清屏
     LCD1602_Write_com_busy(0x06);  //写入新的数据后，光标右移，显示屏不移动
     LCD1602_Write_com_busy(0x0C);  //显示功能开，无光标
} 

//---------------------------------------
//名称：1602液晶指定地址显示函数
//适用：给力者GL9单片机开发学习系统
//公司：宁波芯动电子有限公司
//网址：www.MovingChip.com
//日期：20130702
//---------------------------------------
void LCD1602_Disp(unsigned char x,unsigned char y,unsigned char buf)
{ 
     LCD1602_Write_address(x,y);    //先将地址信息写入
     LCD1602_Write_data_busy(buf);  //再写入要显示的数据
} 
//---------------------------------------
//名称：单总线读字节函数
//适用：给力者GL9单片机开发学习系统
//公司：宁波芯动电子有限公司
//网址：www.MovingChip.com
//日期：20130702
//---------------------------------------
unsigned char	Read1Byte(void)
{     
	unsigned char i;
	unsigned char buf=0;
	for(i=0;i<8;i++)	   //每次读1位数据，共需8次才能读完一个字节
	{	
		P3_6=1;           //读数据前，先把口线置1，做好读的准备
	   Timeout=0;        //超时计数清零
		while((P3_6==0)&&((Timeout++)<500));  //P3_6读为1，或者超时了都退出循环
		TH0=0xff; 			//26-28US后读入一个位，此处为了可靠，延时30微秒
		TL0=0xc8; 			//26-28US后读入一个位，此处为了可靠，延时30微秒
  		TF0=0;	 			//26-28US后读入一个位，此处为了可靠，延时30微秒	
		while(!TF0); 		//26-28US后读入一个位，此处为了可靠，延时30微秒	  
		buf<<=1;          //buf左移一位，因为数据是从最高位先入的
	   if(P3_6==1) buf|=0x01;//如果读进的数据为1，那么把1写在BUF的最低位
		Timeout=0;        //超时计数清零
		while((P3_6==1)&&((Timeout++)<500)); //P3_6读为0，或者超时了都退出循环		
	} 
	return buf;          //读8次后，8位数据保存在BUF中，将BUF作为输出参数返回
}
//---------------------------------------
//名称：握手协议和湿度读取函数
//适用：给力者GL9单片机开发学习系统
//公司：宁波芯动电子有限公司
//网址：www.MovingChip.com
//日期：20130702
//---------------------------------------
//----湿度整数== RH_H-----
//----湿度小数== RH_L-----
//----温度整数== T_H------
//----温度小数== T_L------
//----校验8位 == Checkdata-----
unsigned char ReadRH(void)
{	
   P3_6=0;					//总线拉低
	TH0=0x77; 				//延时19毫秒
	TL0=0x33; 				//延时19毫秒
  	TF0=0; 					//延时19毫秒
	while(!TF0); 			//延时19毫秒
	P3_6=1;              //总线拉高
	TH0=0xff;            //延时50微秒
	TL0=0xa3;            //延时50微秒
  	TF0=0;	            //延时50微秒	
	while(!TF0);         //延时50微秒 
	if(P3_6==0)		 		//50微秒后读总线电平，低电平则收到DHT11的回复信号 
	{
		Timeout=0;
		while((P3_6==0)&&((Timeout++)<500)); //等待上升沿，超时退出
		Timeout=0;
		while((P3_6==1)&&((Timeout++)<500)); //等待下降沿，超时退出 
	   RH_H=Read1Byte(); 		//读第一个字节，内容为湿度参数整数部分   
	   RH_L=Read1Byte(); 		//读第二个字节，内容为湿度参数小数部分	   
	   T_H=Read1Byte();  		//读第三个字节，内容为温度参数整数部分	   
	   T_L=Read1Byte();  		//读第四个字节，内容为温度参数小数部分	  
	   Checkdata=Read1Byte();  //读第五个字节，内容为前四个字节的校验码
	   if(Checkdata==RH_H + RH_L + T_H + T_L)	//如果校验码等于其他4个字节的和
			return 1;	 		//校验成功，返回1
		else
			return 0;	 		//校验失败，返回0
	}
	else
		return 0;		 		//50微秒后读总线电平，高电平则没收到DHT11的回复信号，返回0
}
//---------------------------------------
//名称: 主函数
//适用：给力者GL9单片机开发学习系统
//公司：宁波芯动电子有限公司
//网址：www.MovingChip.com
//日期：20130702
//---------------------------------------
void main(void)            //主函数,单片机开机后就是从这个函数开始运行
{
	//***定时器Timer0初始化***
	TMOD&=0xF0;            //将TMOD的低4位定时器0控制部分清零
   TMOD|=0x01;            //设置定时器0为方式1    
   TR0=1;                 //启动定时器0
   ET0=0;                 //Timer0中断禁止
    //**********************
   LCD1602_init();        //调用1602液晶初始化函数
	while(1)
	{
		if(ReadRH()==1)     //调用读湿度函数，如果返回1，标志着读成功
		{
			LCD1602_Disp(0,0,'R');   //显示R
			LCD1602_Disp(1,0,'H');   //显示H
	   	LCD1602_Disp(2,0,':');   //显示:		
			LCD1602_Disp(3,0,RH_H/10+'0');  //温度整数部分十位	
			LCD1602_Disp(4,0,RH_H%10+'0');  //温度整数部分个位
			LCD1602_Disp(5,0,'%');   //显示%		

			LCD1602_Disp(0,1,'T');   //显示T
	   	LCD1602_Disp(1,1,':');   //显示:	
			LCD1602_Disp(2,1,T_H/10+'0');  //温度整数部分十位		
			LCD1602_Disp(3,1,T_H%10+'0');  //温度整数部分个位
			LCD1602_Disp(4,1,0xdf);   //显示.
			LCD1602_Disp(5,1,0x43);   //显示C		
	   }
	}
}

